/* SPDX-License-Identifier: Apache-2.0 */
/*
 * This file is part of EmbLinkRTOS, a deterministic real-time kernel for microcontrollers.
 * Licensed under the Apache License, Version 2.0; see the LICENSE file at the repository root.
 */

/*******************************************************************************
  System Tasks File

  File Name:
    tasks.c

  Summary:
    tasks_demo's tasks on the pico2_w, and SYS_Tasks().

  Description:
    Each task's thread, queue, dispatch and description: the thread runs the
    task runtime, emb_task_run() (SPEC-020), which calls an event task's handler
    for each event, and a periodic task's _Tasks() every period, without drift.
    SYS_Tasks() starts the kernel.

    Generated by emb-hwgen 0.1.0, schema v0, from the system description and the
    pico2_w's. Yours to edit: regenerating merges its changes with yours (A126):
      hw/gen/emb-hwgen.py generate --system examples/tasks/system.yaml

    Inputs (SHA-256):
      arch/cortex_m/arch.yaml
        c5c8e451c09717dee1713d07f8311b6d507e3b4c66c42d93e0ce11da6ec76d6d
      boards/rpi/pico2_w/board.yaml
        f9063a553d5f2574f744b2822f60f3230499789343103fa856e5e012c2f18638
      drivers/bindings.yaml
        8ebddec3b88fbfaa96769bf53f915ef6e916352d5abf4b9f676210fcb918d2c9
      examples/tasks/system.yaml
        202cff4815e97ab763dc14c61b0b694ee9381307eb46687f9caaea3465a913da
      soc/rpi/rp2350/rp2350.yaml
        80773a9c9cfb1c62cd322e397111a11d7f48fce3c0febc76bf7d5571018977a5
      soc/rpi/rp2350/rp2350a.yaml
        22395e35ed229020b5c9c7586af50cfaa07960a09905776eb4713ff28051eb3c
 *******************************************************************************/

// *****************************************************************************
// *****************************************************************************
// Section: Included Files
// *****************************************************************************
// *****************************************************************************

#include "definitions.h"

// *****************************************************************************
// *****************************************************************************
// Section: RTOS "Tasks" Routine
// *****************************************************************************
// *****************************************************************************

/* ---- door: an event task, its queue 8 deep (SPEC-020) ---- */

_Static_assert(DOOR_STATE_CLOSED == 0, "door.h: DOOR_STATES are system.yaml's states, in order");
_Static_assert(DOOR_STATE_OPEN == 1, "door.h: DOOR_STATES are system.yaml's states, in order");
_Static_assert(DOOR_STATE_JAMMED == 2, "door.h: DOOR_STATES are system.yaml's states, in order");
_Static_assert(DOOR_EVENT_OPEN == EMB_EV_USER + 0u,
               "door.h: DOOR_EVENTS are system.yaml's events, in order");
_Static_assert(DOOR_EVENT_CLOSE == EMB_EV_USER + 1u,
               "door.h: DOOR_EVENTS are system.yaml's events, in order");
_Static_assert(DOOR_EVENT_JAM == EMB_EV_USER + 2u,
               "door.h: DOOR_EVENTS are system.yaml's events, in order");

static emb_task_event_t door_event;
EMB_MSGQ_DEFINE(door_task_queue, sizeof(emb_task_event_t), DOOR_QUEUE_LENGTH, 0u);
static const uint32_t door_timeouts[3] = {0u, DOOR_OPEN_TIMEOUT_MS, 0u};

static emb_state_t door_dispatch(emb_state_t state, uint8_t why)
{
    emb_state_t next = state; /* a state the task lacks stays: the runtime faults on it */
    if (why == EMB_TASK_WHY_TIMEOUT) {
        door_event.id = EMB_EV_TIMEOUT;
        door_event.value = 0u;
    }
    switch (state) {
    case DOOR_STATE_CLOSED:
        doorData.state = DOOR_STATE_CLOSED;
        next = (emb_state_t)DOOR_OnClosed(&door_event);
        break;
    case DOOR_STATE_OPEN:
        doorData.state = DOOR_STATE_OPEN;
        next = (emb_state_t)DOOR_OnOpen(&door_event);
        break;
    case DOOR_STATE_JAMMED:
        doorData.state = DOOR_STATE_JAMMED;
        next = (emb_state_t)DOOR_OnJammed(&door_event);
        break;
    default:
        break;
    }
    return next;
}

static void door_enter(emb_state_t state)
{
    switch (state) {
    case DOOR_STATE_CLOSED:
        doorData.state = DOOR_STATE_CLOSED;
        break;
    case DOOR_STATE_OPEN:
        doorData.state = DOOR_STATE_OPEN;
        DOOR_EnterOpen();
        break;
    case DOOR_STATE_JAMMED:
        doorData.state = DOOR_STATE_JAMMED;
        break;
    default:
        break;
    }
}

static void door_exit(emb_state_t state)
{
    if (state == DOOR_STATE_OPEN) {
        DOOR_ExitOpen();
    }
}

static const emb_task_desc_t door_desc = {
    .name = "door",
    .dispatch = door_dispatch,
    .enter = door_enter,
    .leave = door_exit,
    .event = &door_event,
    .queue = &door_task_queue,
    .timeout_ms = door_timeouts,
    .period_ms = 0u,
    .event_size = (uint16_t)sizeof(emb_task_event_t),
    .initial = (emb_state_t)DOOR_STATE_CLOSED,
    .count = 3u,
    .model = EMB_TASK_EVENT,
};
emb_task_t door_task = {.desc = &door_desc, .state = (emb_state_t)DOOR_STATE_CLOSED};

static void door_main(void *arg)
{
    (void)arg;
    emb_task_run(&door_task);
}

EMB_THREAD_DEFINE(door_thread, door_main, NULL, DOOR_PRIORITY, DOOR_STACK_SIZE, 0u);

/* ---- blink: a periodic task, every 500 ms (SPEC-020) ---- */

_Static_assert(BLINK_STATE_DARK == 0, "blink.h: BLINK_STATES are system.yaml's states, in order");
_Static_assert(BLINK_STATE_LIT == 1, "blink.h: BLINK_STATES are system.yaml's states, in order");

static emb_state_t blink_dispatch(emb_state_t state, uint8_t why)
{
    (void)state;
    (void)why;
    BLINK_Tasks();
    return (emb_state_t)blinkData.state;
}

static const emb_task_desc_t blink_desc = {
    .name = "blink",
    .dispatch = blink_dispatch,
    .enter = NULL,
    .leave = NULL,
    .event = NULL,
    .queue = NULL,
    .timeout_ms = NULL,
    .period_ms = BLINK_PERIOD_MS,
    .event_size = 0u,
    .initial = (emb_state_t)BLINK_STATE_DARK,
    .count = 2u,
    .model = EMB_TASK_PERIODIC,
};
emb_task_t blink_task = {.desc = &blink_desc, .state = (emb_state_t)BLINK_STATE_DARK};

static void blink_main(void *arg)
{
    (void)arg;
    emb_task_run(&blink_task);
}

EMB_THREAD_DEFINE(blink_thread, blink_main, NULL, BLINK_PRIORITY, BLINK_STACK_SIZE, 0u);

// *****************************************************************************
// *****************************************************************************
// Section: System "Tasks" Routine
// *****************************************************************************
// *****************************************************************************

/*******************************************************************************
  Function:
    void SYS_Tasks ( void )

  Remarks:
    See prototype in definitions.h.
 */
void SYS_Tasks(void)
{
    /* Start the kernel: the threads and the tasks run from here. It does not return. */
    emb_kernel_start();
}
/*******************************************************************************
 End of File
*/
