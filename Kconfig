## arch/avr/Kconfig
```kconfig
# SPDX-License-Identifier: Apache-2.0
# Copyright 2026 Junior Deogracias
# AVR port options (SPEC-012). The tiny defaults are mandatory on this port (§2, §14).

if EMB_ARCH_AVR

menu "AVR port"

config EMB_AVR_MCU
	string "Device name for the compiler (-mmcu)"
	default "atmega328p"

config EMB_AVR_F_CPU
	int "CPU clock in Hz"
	default 16000000
	range 1000000 20000000
	help
	  From the board description (SPEC-012 §11). 16 MHz on the Arduino Uno.

config EMB_AVR_ISR_STACK_RESERVE
	int "Per-thread interrupt stack reserve, bytes"
	default 64
	range 40 255
	help
	  SPEC-002 §7.2, SPEC-012 §5: the 37-byte EMB_ISR frame plus the largest
	  kernel-aware handler's C frame. Added to every thread stack budget.

config EMB_AVR_TIMER1_PRESCALER
	int "Timer1 prescaler for the periodic tick"
	default 64
	range 1 1024
	help
	  SPEC-012 §7: prescaler 64 with OCR1A = 249 gives an exact 1 ms tick at 16 MHz.

endmenu

require EMB_SCHED_TABLE "SPEC-012 §2: the table scheduler is mandatory on the AVR port"
require EMB_TICK_32BIT "SPEC-012 §2: 32-bit time is mandatory on the AVR port"
require EMB_NOTIFY_BITS = 8 "SPEC-012 §2: 8-bit notifications are mandatory on the AVR port"
require !EMB_IDLE_THREAD "SPEC-012 §2: the AVR port uses the inline idle context (ADR-036)"

endif
```

## arch/cortex_m/Kconfig
```kconfig
# SPDX-License-Identifier: Apache-2.0
# Copyright 2026 Junior Deogracias
# Cortex-M port options (docs/ports/cortex_m.md). Board values come from board.conf.

if EMB_ARCH_CORTEX_M

menu "Cortex-M port"

config EMB_CM_CPU_HZ
	int "Processor clock in Hz (SysTick runs on it)"
	default 25000000
	range 1000000 1000000000

config EMB_CM_IRQ_COUNT
	int "External interrupt lines in the vector table"
	default 32
	range 1 128

config EMB_CM_KERNEL_BASEPRI
	int "BASEPRI value of the kernel's critical section"
	default 32
	range 1 254
	help
	  Interrupts with a priority byte below this value are zero-latency: never masked
	  by the kernel and not allowed to call it (SPEC-002 §3). 32 is priority level 1
	  on a part with 3 priority bits.

config EMB_CM_IRQ_PRIORITY
	int "Default priority byte of a kernel-aware interrupt"
	default 128
	range 1 254

config EMB_CM_IRQ_PRIORITY_BITS
	int "Priority bits exposed by the board's Cortex-M port"
	default 3
	range 3 7
	help
	  Declare implemented high bits, or a conservative subset, in board.conf.
	  PRIGROUP=0 gives these bits preemption semantics. At most seven bits are
	  exposed because the eighth would be subpriority, not preemption priority.

config EMB_CM_TIMER_LEVEL
	int "Generic SysTick priority (defaults to the highest kernel-aware level)"
	default EMB_IRQ_KERNEL_LEVEL
	range 0 EMB_IRQ_KERNEL_LEVEL

endmenu

require EMB_IRQ_DYNAMIC "the Cortex-M port binds handlers with emb_irq_connect() (docs/ports/cortex_m.md)"
require !EMB_TICKLESS "the Cortex-M port implements the periodic SysTick tick only in this milestone"
require !EMB_IRQ_ZERO_LATENCY "raw kernel-independent vectors are not implemented by the current Cortex-M port"
require EMB_CM_IRQ_PRIORITY >= EMB_CM_KERNEL_BASEPRI "a kernel-aware interrupt must be masked by the kernel's BASEPRI"

endif
```

## arch/riscv/Kconfig
```kconfig
# SPDX-License-Identifier: Apache-2.0
# Copyright 2026 Junior Deogracias
# RISC-V port options (docs/ports/riscv.md). Board values come from board.conf.

if EMB_ARCH_RISCV

menu "RISC-V port"

config EMB_RV_ESP32C3
	bool "ESP32-C3: SYSTIMER and the interrupt matrix in place of the CLINT"
	default n
	help
	  The tick is SYSTIMER's comparator 0 in period mode on CPU interrupt 2, interrupt
	  0 is FROM_CPU_INTR0 on CPU interrupt 1, mtvec is vectored, and the boot ROM's
	  watchdogs are stopped at startup (docs/ports/riscv.md).

config EMB_RV_MTIME_HZ
	int "Frequency of the machine timer (mtime, or the ESP32-C3's SYSTIMER) in Hz"
	default 10000000
	range 32768 1000000000

config EMB_RV_CLINT_BASE
	hex "Base address of the CLINT (msip, mtimecmp, mtime)"
	default 0x02000000

config EMB_RV_IRQ_COUNT
	int "Interrupt numbers: 0 is the machine software interrupt, 1.. the PLIC sources"
	default 8
	range 1 1024

endmenu

require EMB_IRQ_DYNAMIC "the RISC-V port binds handlers with emb_irq_connect() (docs/ports/riscv.md)"
require !EMB_TICKLESS "the RISC-V port implements the periodic machine-timer tick only in this milestone"

endif
```
