## kernel/Kconfig
```kconfig
# SPDX-License-Identifier: Apache-2.0
# Copyright 2026 Junior Deogracias
#
# This file is part of EmbLinkRTOS, a deterministic real-time kernel for microcontrollers.
# Licensed under the Apache License, Version 2.0; see the LICENSE file at the repository root.

# Kernel options. Defaults follow the reference profiles of 03 §11 and the per-specification
# values; a symbol's help names the specification that defines its meaning.

menu "Kernel"

choice EMB_PROFILE_CHOICE
	prompt "Reference profile (02 §7, 03 §11)"
	default EMB_PROFILE_BASE

config EMB_PROFILE_TINY
	bool "tiny: table scheduler, 32-bit time, 8-bit notifications, no idle thread"

config EMB_PROFILE_BASE
	bool "base: bitmap scheduler, 64-bit time, 32-bit notifications"

endchoice

config EMB_PROFILE
	string
	default "tiny" if EMB_PROFILE_TINY
	default "base" if EMB_PROFILE_BASE

config EMB_CHECKED
	bool "Checked build: misuse faults, invariant checks, stack guards"
	default y
	help
	  SPEC-001 §5.3. A release build returns status codes where a checked build faults.

menu "Scheduler"

config EMB_SCHED_TABLE
	bool "Table scheduler: one thread per priority, one-word ready set (ADR-036)"
	default y if EMB_PROFILE_TINY
	default n

config EMB_PRIORITY_COUNT
	int "Number of priority levels including idle level 0"
	default 8 if EMB_PROFILE_TINY
	default 32
	range 2 EMB_ARCH_WORD_BITS if EMB_SCHED_TABLE
	range 2 256
	help
	  KRN-SCH-036: application priorities are 1 .. EMB_PRIORITY_COUNT - 1; 0 is idle.
	  With the table scheduler the count is bounded by the architecture word width.

config EMB_TIME_SLICING
	bool "Round-robin time slicing among equal priorities (KRN-SCH-007, KRN-SCH-037)"
	depends on !EMB_SCHED_TABLE
	default n
	help
	  A thread at or below EMB_TIMESLICE_PRIORITY that runs for EMB_TIMESLICE_TICKS
	  without blocking, yielding or being preempted moves behind its equal-priority
	  peers (KRN-SCH-026). The quantum starts at dispatch. The table scheduler has one
	  thread per level, so it has no peers to rotate among.

config EMB_TIMESLICE_TICKS
	int "Quantum in ticks"
	depends on EMB_TIME_SLICING
	default 10
	range 1 65535

config EMB_TIMESLICE_PRIORITY
	int "Highest priority level that is time sliced"
	depends on EMB_TIME_SLICING
	default 255
	range 1 255
	help
	  KRN-SCH-037: slicing applies to threads whose effective priority is at or below
	  this level; 255 slices every level. Higher levels run until they block or yield.

config EMB_IDLE_THREAD
	bool "Dedicated idle thread (off: inline idle context, ADR-036)"
	default n if EMB_PROFILE_TINY
	default y

config EMB_IDLE_STACK_SIZE
	int "Idle thread stack size, bytes"
	depends on EMB_IDLE_THREAD
	default 256
	range EMB_ARCH_STACK_MIN 65536

endmenu

menu "Time"

config EMB_TICK_NS
	int "Tick length in nanoseconds"
	default 1000000
	range 1000 100000000
	help
	  SPEC-003 §3. Default 1 ms.

config EMB_TICK_32BIT
	bool "32-bit tick counter (tiny profile)"
	default y if EMB_PROFILE_TINY
	default n
	help
	  SPEC-003 §3, §5.2: finite timeouts are capped at 2^31 - 1 ticks.

config EMB_TICKLESS
	bool "Tickless clock: program the timer for the next deadline only"
	depends on EMB_ARCH_HAS_TICKLESS
	default y if EMB_ARCH_NATIVE
	default n
	help
	  SPEC-003 §4.2. Periodic tick otherwise.

endmenu

menu "Threads"

config EMB_STACK_CHECK
	bool "Guard-word check at every switch-out (KRN-MEM-010)"
	default EMB_CHECKED

config EMB_STACK_STATS
	bool "Stack fill and high-water statistics (KRN-MEM-009)"
	default n

config EMB_TLS_SLOTS
	int "Thread-local storage slots per thread (SPEC-008 §9)"
	default 0
	range 0 16

config EMB_THREAD_LIST
	bool "Keep the all-threads list for emb_thread_foreach and the debug descriptor"
	default n if EMB_PROFILE_TINY
	default y

config EMB_OBJ_NAMES
	bool "Keep object name pointers"
	default n if EMB_PROFILE_TINY
	default y

config EMB_STATUS_NAMES
	bool "Compile emb_status_name()"
	default n if EMB_PROFILE_TINY
	default y
	help
	  SPEC-001 §14 decision 4.

endmenu

menu "Synchronization"

config EMB_NOTIFY
	bool "Thread notifications (SPEC-006 §2)"
	default y

config EMB_NOTIFY_BITS
	int "Notification word width: 8, 16, or 32"
	depends on EMB_NOTIFY
	default 8 if EMB_PROFILE_TINY
	default 32
	range 8 32

config EMB_SEM
	bool "Counting semaphores (SPEC-005 §4)"
	default y

config EMB_SEM_COUNT_BITS
	int "Semaphore count width: 8, 16, or 32"
	depends on EMB_SEM
	default 8 if EMB_PROFILE_TINY
	default 32
	range 8 32

config EMB_EVENT
	bool "Event flags (SPEC-005 §5)"
	default y

config EMB_EVENT_BITS
	int "Event flag word width: 8, 16, or 32"
	depends on EMB_EVENT
	default 8 if EMB_PROFILE_TINY
	default 32
	range 8 32

config EMB_MUTEX
	bool "Mutexes (SPEC-005 §3)"
	default y

config EMB_COND
	bool "Condition variables (SPEC-005 §6)"
	depends on EMB_MUTEX
	default n if EMB_PROFILE_TINY
	default y

config EMB_MUTEX_INHERIT
	bool "Priority inheritance protocol"
	depends on EMB_MUTEX
	default y

config EMB_PI_MAX_DEPTH
	int "Maximum inheritance chain depth (SPEC-005 §2.2)"
	depends on EMB_MUTEX_INHERIT
	default 8
	range 1 32

config EMB_PI_HOP_SECTIONS
	bool "Release the critical section between inheritance hops"
	depends on EMB_MUTEX_INHERIT
	default n if EMB_ARCH_AVR
	default y

choice EMB_MUTEX_OWNER_DEATH_CHOICE
	prompt "Owner death policy (SPEC-005 §3.6)"
	depends on EMB_MUTEX
	default EMB_MUTEX_OWNER_DEATH_FAULT

config EMB_MUTEX_OWNER_DEATH_FAULT
	bool "FAULT: a thread exiting with owned mutexes is a fault in checked builds"

config EMB_MUTEX_OWNER_DEATH_RELEASE
	bool "RELEASE: hand over or mark inconsistent, EMB_EOWNERDEAD to the next locker"

endchoice

config EMB_MUTEX_OWNER_DEATH
	string
	default "FAULT" if EMB_MUTEX_OWNER_DEATH_FAULT
	default "RELEASE" if EMB_MUTEX_OWNER_DEATH_RELEASE
	default "FAULT"

config EMB_MUTEX_CEILING_STATIC_ONLY
	bool "Ceiling mutexes without a wait queue (every user declared, SPEC-005 §3.4)"
	depends on EMB_MUTEX
	default y if EMB_PROFILE_TINY
	default n

endmenu

menu "Inter-thread communication"

config EMB_MSGQ
	bool "Message queues (SPEC-007 §2)"
	default y

config EMB_MSGQ_MAX_ITEM
	int "Largest message queue item in bytes (SPEC-007 §2.2)"
	depends on EMB_MSGQ
	default 16 if EMB_PROFILE_TINY
	default 64
	range 1 255 if EMB_IPC_SMALL
	range 1 1024
	help
	  Bounds the copy each send or receive makes with interrupts masked (KRN-IPC-011).
	  Larger payloads belong in a buffer pool, passed by pointer.

config EMB_IPC_SMALL
	bool "8-bit IPC counts: at most 255 items per queue (KRN-IPC-021)"
	default y if EMB_PROFILE_TINY
	default n

endmenu

menu "Software timers"

config EMB_TIMER
	bool "Software timers (SPEC-003 §7)"
	depends on !EMB_SCHED_TABLE
	default y
	help
	  One-shot and periodic timers whose callbacks run on a work queue, or in the expiry
	  interrupt with EMB_TIMER_ISR_CONTEXT. The tiny profile's table scheduler has no
	  timers in M2.

endmenu

menu "Work queues"

config EMB_DEVICE
	bool "Devices and driver requests (SPEC-016)"
	depends on EMB_NOTIFY && EMB_SEM
	default n if EMB_PROFILE_TINY || EMB_ARCH_AVR
	default y
	help
	  Device instances with a lifecycle, and the request and completion core every driver
	  class is built on: queued requests, completion by notification, semaphore, work item
	  or callback, cancellation, and a blocking wrapper. Off on the tiny profile and AVR,
	  whose boards keep their free functions.

config EMB_DRV_UART
	bool "The UART class (SPEC-017 §4)"
	depends on EMB_DEVICE
	default y
	help
	  Requests to write and read bytes, their blocking wrappers, the polled
	  calls, and the receive core every UART driver shares.

config EMB_DRV_GPIO
	bool "The GPIO class (SPEC-017 §5a)"
	depends on EMB_DEVICE
	default y
	help
	  A controller's lines set up as inputs or outputs, driven and read from
	  any context: chip selects, resets, LEDs.

config EMB_DRV_WDT
	bool "The watchdog class (SPEC-017 §8)"
	depends on EMB_DEVICE
	default y
	help
	  A hardware watchdog started once with its timeout, fed from any context,
	  never stopped; and whether it caused the last reset.

config EMB_WALLCLOCK
	bool "The wall clock (SPEC-003 §10, KRN-TIM-031)"
	depends on !EMB_TICK_32BIT
	default y if !EMB_PROFILE_TINY
	help
	  Calendar time, nanoseconds since the Unix epoch: the monotonic clock
	  plus an offset that setting or adjusting it changes, and a board's
	  RTC seeds at boot. No timeout or deadline depends on it. It needs
	  64-bit ticks, which do not wrap.

config EMB_DRV_RTC
	bool "The RTC class (SPEC-017 §10)"
	depends on EMB_DEVICE
	default y
	help
	  A real-time clock kept across resets: its time get and set, one
	  alarm, and backup registers where the part has them. With the wall
	  clock, a set RTC seeds it when the device starts.

config EMB_DRV_COUNTER
	bool "The counter class (SPEC-017 §11a, A129)"
	depends on EMB_DEVICE
	default y
	help
	  A free-running counter at a known rate, widened to 64 bits: one-shot
	  alarms on its channels and periodic callbacks without drift, each in
	  the counter's interrupt.

config EMB_DRV_PWM
	bool "The PWM class (SPEC-017 §11b, A129)"
	depends on EMB_DEVICE
	default y
	help
	  Output channels set by period and pulse in nanoseconds, the channels
	  of a device sharing its period; and an input's period and pulse
	  measured, one cycle exactly or averaged over many.

config EMB_DRV_ENTROPY
	bool "The entropy class (SPEC-017 §11)"
	depends on EMB_DEVICE
	default y
	help
	  Bytes from a hardware source of randomness, each block through the
	  source's health tests. A board without a source has no entropy
	  device and says so (EMB_ENOTSUP): nothing stands in for one.

config EMB_DRV_FLASH
	bool "The flash class and partitions (SPEC-017 §9)"
	depends on EMB_DEVICE
	default y
	help
	  A NOR flash read, programmed and erased by offset, its geometry from
	  the description, each operation run to its end in the caller; and
	  the board's flash partitions, <emb/flash_area.h>.

config EMB_TIME_CATCH_UP
	bool
	default y if EMB_DRV_FLASH && !EMB_TICKLESS
	help
	  The periodic tick adds the ticks that passed while interrupts were
	  held off, or the core stalled, for longer than a tick: a flash
	  operation (A122). The port counts them; without this the hook does
	  nothing, and costs no RAM.

config EMB_WDOG
	bool "The software watchdog (FLT-004)"
	depends on EMB_DRV_WDT && EMB_TIMER
	default y
	help
	  Feeds the hardware watchdog only while every party it watches has
	  checked in within its window, from a timer in the timer interrupt. A
	  party that misses its window is written into the crash record
	  (EMB_FAULT_WATCHDOG), and the hardware watchdog resets the part.

config EMB_DRV_DMA
	bool "The DMA class (SPEC-017 §7)"
	depends on EMB_DEVICE
	default y
	help
	  Channels a driver's device is given at generation, jobs started on them
	  and their ends delivered to the driver: for drivers, not applications.

config EMB_DRV_I2C
	bool "The I2C class (SPEC-017 §6)"
	depends on EMB_DEVICE && EMB_MUTEX_INHERIT
	default y
	help
	  Transactions of write and read segments to a target's address, joined by
	  repeated starts; and, as a target, the transactions another controller
	  makes to this one's own address.

config EMB_DRV_SPI
	bool "The SPI controller class (SPEC-017 §5)"
	depends on EMB_DEVICE && EMB_DRV_GPIO && EMB_MUTEX_INHERIT
	default y
	help
	  Transfers to a target in its mode, at its speed and word size, and their
	  blocking wrapper; each target's chip select, and the bus held across
	  several transfers by a mutex with priority inheritance.

config EMB_TASK
	bool "Tasks: threads written as state machines (SPEC-020)"
	depends on EMB_MSGQ
	default n if EMB_PROFILE_TINY
	default y
	help
	  A task's states, events and handlers come from the system description;
	  the runtime runs its machine, by events on its own queue or by period.
	  Linked only into an image that has tasks.

config EMB_WORKQ
	bool "Work queues (SPEC-006 §4)"
	depends on EMB_NOTIFY && !EMB_SCHED_TABLE
	default y
	help
	  A kernel thread per queue runs submitted items in order. The tiny profile's table
	  scheduler has no work queues in M2.

config EMB_WORKQ_STATS
	bool "Per-queue work statistics (KRN-WQ-011)"
	depends on EMB_WORKQ
	default n
	help
	  Each queue records the most items it held at once, the worst submit-to-start
	  latency and the longest handler with its address, read with
	  emb_workq_get_stats(). Costs a timestamp per work item and two clock reads per
	  handler run.

config EMB_SYSTEM_WORKQ
	bool "The system work queue, linked only when referenced (ADR-048)"
	depends on EMB_WORKQ
	default y

config EMB_SYSTEM_WORKQ_PRIO
	int "System work queue priority; 0 selects the second-highest priority"
	depends on EMB_SYSTEM_WORKQ
	default 0
	range 0 255

config EMB_SYSTEM_WORKQ_STACK
	int "System work queue stack size, bytes"
	depends on EMB_SYSTEM_WORKQ
	default 2048
	range EMB_ARCH_STACK_MIN 65536

endmenu

menu "Objects"

choice EMB_HANDLE_MODEL_CHOICE
	prompt "Handle model (SPEC-009, ADR-014)"
	default EMB_HANDLE_MODEL_POINTER

config EMB_HANDLE_MODEL_POINTER
	bool "POINTER: the handle word is the object address"

endchoice

config EMB_HANDLE_MODEL
	string
	default "POINTER" if EMB_HANDLE_MODEL_POINTER

config EMB_OBJ_LIST
	bool "Keep a per-type list of active objects (KRN-OBJ-011)"
	default n if EMB_PROFILE_TINY
	default y
	help
	  SPEC-009 §6, §7. Init refuses storage that still holds an active
	  object of its type, exactly, by looking it up in the list. Without
	  the list, init on such storage is undefined.

endmenu

menu "Interrupts"

config EMB_IRQ_ZERO_LATENCY
	bool "Kernel-independent interrupt class (SPEC-002 §3.2)"
	depends on EMB_ARCH_HAS_ZERO_LATENCY_IRQS
	default n

config EMB_IRQ_KERNEL_LEVEL
	int
	default 0
	range 0 255
	help
	  Derived highest kernel-aware level; Cortex-M uses its priority width and
	  BASEPRI threshold. Fixed-level ports expose only level 0.

config EMB_IRQ_LEVEL_MAX
	int
	default 0
	range 0 255
	help
	  Derived highest level implemented by the current port configuration.

config EMB_IRQ_NESTING
	bool "Allow kernel-aware interrupts to nest (SPEC-002 §7.1)"
	depends on EMB_ARCH_HAS_IRQ_NESTING
	default y

config EMB_IRQ_MAX_NESTING
	int "Nesting depth the interrupt stack is sized for"
	default 4 if EMB_IRQ_NESTING
	default 1
	range 1 64

config EMB_IRQ_LOCK_STATS
	bool "Measure critical-section durations with the cycle counter"
	depends on EMB_ARCH_HAS_CYCLE_COUNTER
	default n

config EMB_IRQ_DYNAMIC
	bool "Runtime emb_irq_connect() with a RAM handler table"
	default n if EMB_ARCH_AVR
	default y

config EMB_ISR_STACK_SIZE
	int "Dedicated interrupt stack size, bytes"
	depends on EMB_ARCH_HAS_INTERRUPT_STACK
	default 2048 if EMB_ARCH_CORTEX_M
	default 1024
	range 256 1048576
	help
	  SPEC-002 §7.2, A90: the stack every kernel-aware interrupt, nested ones and the
	  pre-kernel code included, runs on (Cortex-M's MSP, RISC-V's trap stack). Checked
	  builds fill it at kernel init and check its lowest bytes at every outermost
	  interrupt exit; emb_isr_stack_info() reports its high-water mark for sizing.
	  On Armv8-M Mainline MSPLIM stops an overflow 384 bytes above its bottom, the room
	  the fault path runs in. Cortex-M's default is larger for FPU frames at each
	  nesting level.

endmenu

menu "Faults"

choice EMB_FAULT_ACTION_CHOICE
	prompt "Action after a kernel fault is recorded (03 §10)"
	default EMB_FAULT_ACTION_REBOOT if EMB_ARCH_AVR
	default EMB_FAULT_ACTION_HALT

config EMB_FAULT_ACTION_HALT
	bool "HALT: stop with interrupts masked"

config EMB_FAULT_ACTION_REBOOT
	bool "REBOOT: reset through the architecture's reset path"

endchoice

config EMB_FAULT_ACTION
	string
	default "HALT" if EMB_FAULT_ACTION_HALT
	default "REBOOT" if EMB_FAULT_ACTION_REBOOT

config EMB_FAULT_WHERE
	bool "Record the faulting function's name in the fault information"
	default n if EMB_PROFILE_TINY
	default y
	help
	  The strings cost flash, and RAM on AVR (03 §10.2 crash record location).

config EMB_FAULT_HALT_FOR_DEBUG
	bool "Execute a breakpoint before the fault action (SPEC-011 §14)"
	default y if EMB_CHECKED && !EMB_ARCH_AVR
	default n

config EMB_FAULT_HOOK_RUNTIME
	bool "Register the fault hook at run time with emb_fault_set_hook()"
	default y
	help
	  API-017. Off: the kernel calls emb_fault_hook(), which the application
	  defines (a weak empty default exists where the compiler has weak
	  symbols), and keeps no hook pointer in RAM.

endmenu

menu "Observability"

config EMB_DEBUG_DESCRIPTOR
	bool "Debug descriptor for RTOS-aware tools (SPEC-015 §5, OBS-008)"
	default n if EMB_PROFILE_TINY || EMB_ARCH_AVR
	default y
	help
	  A read-only table at the symbol emb_debug_descriptor: where the
	  kernel keeps its threads and the offsets of their fields, and the
	  port's switch frame. A debugger plugin or tools/descriptor reads it
	  to list threads, their states, stacks and owned mutexes, and the
	  registers of a switched-out thread (A107). Off on AVR, where
	  constants take RAM.

config EMB_TRACE
	bool "Kernel trace points (SPEC-015)"
	default y if EMB_ARCH_NATIVE
	default n

config EMB_CRASH_RECORD
	bool "Crash record kept across reset (SPEC-015 §4, OBS-016)"
	default n if EMB_PROFILE_TINY
	default y
	help
	  A kernel fault writes a record of itself (fault class, code, API
	  and argument, thread, addresses, uptime, build identity) into memory
	  the port's reset leaves alone, before the hook and the fault action.
	  The next boot validates it and emb_crash_record_get() returns it.
	  Version 1 on 32-bit and native ports (92 bytes), the small version 2
	  on AVR (34 bytes of .noinit). Off by default on the tiny profile: on
	  AVR its code (about 1 KiB) does not fit the tiny footprint gates (A73).

config EMB_FW_VERSION
	string "Firmware version recorded in the crash record (8 bytes)"
	depends on EMB_CRASH_RECORD
	default "0.2.0"

endmenu

endmenu

require EMB_NOTIFY_BITS = 8 || EMB_NOTIFY_BITS = 16 || EMB_NOTIFY_BITS = 32 "EMB_NOTIFY_BITS must be 8, 16, or 32"
require EMB_SEM_COUNT_BITS = 8 || EMB_SEM_COUNT_BITS = 16 || EMB_SEM_COUNT_BITS = 32 "EMB_SEM_COUNT_BITS must be 8, 16, or 32"
require !EMB_SCHED_TABLE || EMB_PRIORITY_COUNT <= EMB_ARCH_WORD_BITS "the table scheduler needs EMB_PRIORITY_COUNT <= EMB_ARCH_WORD_BITS (ADR-036)"
```
